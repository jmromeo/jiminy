/*  
* Copyright (C) 2012 Texas Instruments Incorporated - http://www.ti.com/
*
* This program is free software; you can redistribute it and/or modify
* it under the terms of the GNU General Purpose License Version 2 as
* published by the Free Software Foundation
*
* Original from: github.com/jadonk/validation-scripts/blob/master/test-capemgr/ 
*/

/dts-v1/;
/plugin/;

/{
    compatible = "ti,beaglebone", "ti,beaglebone-black";
    part-number = "ML-CAPE";
    version = "00A0";
    

    // GPIO PinMux Setup
    fragment@0 {
        target = <&am33xx_pinmux>;
            
        __overlay__ {
            ml_cape_gpio: ML_CAPE_Pins {

                pinctrl-single,pins = <
                    0x078 0x07  /* P9_12 60 OUTPUT MODE7          - The LED Output */
                    0x184 0x26  /* P9_24 15 INPUT  MODE6 pulldown - Ultrasonic Sensor Right */
                    0x19C 0x26  /* P9_28 15 INPUT  MODE6 pulldown - Ultrasonic Sensor Center */
                    0x198 0x26  /* P9_30 15 INPUT  MODE6 pulldown - Ultrasonic Sensor Left */
                    0x034 0x26  /* P8_11 45 INPUT  MODE6 pulldown - Yellow Wire */
                    0x030 0x26  /* P8_12 44 INPUT  MODE6 pulldown - Green Wire */
                    0x03C 0x26  /* p8_15 23 INPUT  MODE6 pulldown - Yellow Wire */
                    0x038 0x26  /* P8_16 23 INPUT  MODE6 pulldown - Green Wire */
                    0x084 0x26  /* P8_20 23 INPUT  MODE6 pulldown - White Wire */
                                           
                    /* OUTPUT  GPIO(mode7) 0x07 pulldown, 0x17 pullup, 0x?f no pullup/down */
                    /* INPUT   GPIO(mode6) 0x27 pulldown, 0x37 pullup, 0x?f no pullup/down */
			          >;
		        };
        };
    };

    // Enable PRU
    fragment@1 {
		    target = <&pruss>;

		    __overlay__ {
            pinctrl-names = "default";
            pinctrl-0 = <&ml_cape_gpio>;
            status = "okay";
        };
    };

};
